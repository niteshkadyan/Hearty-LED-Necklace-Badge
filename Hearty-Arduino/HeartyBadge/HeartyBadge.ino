const PROGMEM unsigned short Data[][8] = {
  {0b00000000, 0b00000000, 0b00000000, 0b00000000, 0b00000000, 0b00000000, 0b00000000, 0b00000000},//Space
  {0b00000100, 0b00000100, 0b00000100, 0b00000100, 0b00000100, 0b00000100, 0b00000000, 0b00000100},// !
  {0b00001010, 0b00001010, 0b00001010, 0b00000000, 0b00000000, 0b00000000, 0b00000000, 0b00000000},// "
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  {0b00000000, 0b00000000, 0b00000000, 0b00001010, 0b00011110, 0b00010100, 0b00000000, 0b00000000}//  ~
}; 

unsigned int DisplayBuffer[][8] = {{0, 0}, {0, 0}, {0, 0}, {0, 0}, {0, 0}, {0, 0}, {0, 0}, {0, 0}};
unsigned int speed;
unsigned int i, l, k, ShiftAmount, scroll, temp, shift_step = 1, StringLength;
String message = "HOPE~LOVE[~THANKYOU~BELIEVE~";
char index;

uint8_t rowPins[8] = {9, 10, 2, 3, 4, 5, 6, 7};

#define SER_PIN 11
#define SCK_PIN 12
#define RCK_PIN 8

void setup() {
  for (int i = 0; i < 8; i++) {
    pinMode(rowPins[i], OUTPUT);
  }
  pinMode(SER_PIN, OUTPUT);
  pinMode(SCK_PIN, OUTPUT);
  pinMode(RCK_PIN, OUTPUT);

  Serial.begin(9600);
  Serial.setTimeout(200);

  test();
  delay(2000);
}

int row = 0;

void loop() {
  
  if(Serial.available() > 0){
      message = Serial.readString();
   }
  StringLength = message.length() ;

  for (k = 0; k < StringLength; k++) {
    for (scroll = 0; scroll < (8 / shift_step); scroll++) {
      for (ShiftAmount = 0; ShiftAmount < 8; ShiftAmount++) {

        DisplayBuffer[0][ShiftAmount] <<= 1;
        if (DisplayBuffer[1][ShiftAmount] & 0x80) {
          DisplayBuffer[0][ShiftAmount] |= 1;
        }

        index = message[k];
        temp = pgm_read_byte_near(&Data[index - 32][ShiftAmount]);
        DisplayBuffer[1][ShiftAmount] = (DisplayBuffer[1][ShiftAmount] << shift_step) | (temp >> ((8 - shift_step) - scroll * shift_step));
      }

      speed = 10;
      for (l = 0; l < speed; l++) {
        for (i = 0; i < 8; i++) {
          write595(DisplayBuffer[0][i]);
          write595(DisplayBuffer[1][i]);
          delayMicroseconds(50);
          digitalWrite(rowPins[row], HIGH);
          delay(1);
          digitalWrite(rowPins[row], LOW);
          row++;
          if (row >= 8)
            row = 0;
        }
      }
    }
  }
}

void test(){
  for(int i = 0; i < 8; i++){
    digitalWrite(rowPins[i], HIGH);
  }
  write595(0xff);
  write595(0xff);
}

void write595(byte data) {
  digitalWrite(RCK_PIN, LOW);
  shiftOut(SER_PIN, SCK_PIN, MSBFIRST, data);
  digitalWrite(RCK_PIN, HIGH);
}

